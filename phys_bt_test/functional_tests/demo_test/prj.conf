## CMakeLists.txt
```
cmake_minimum_required(VERSION 3.20.0)

find_package(Zephyr REQUIRED HINTS $ENV{ZEPHYR_BASE})
project(phys_demo_test)

target_sources(app PRIVATE src/main.c)

if(CONFIG_BT_CENTRAL)
    target_sources(app PRIVATE src/central.c)
endif()

if(CONFIG_BT_PERIPHERAL)
    target_sources(app PRIVATE src/peripheral.c)
endif()
```

## prj.conf
```kconfig
CONFIG_BT=y
CONFIG_LOG=y
CONFIG_BT_DEVICE_NAME="PhysTest"
```

## src/main.c
```c
#include <zephyr/kernel.h>
#include <zephyr/sys/printk.h>

extern void central_main(void);
extern void peripheral_main(void);

int main(void)
{
    printk("Starting Physical Bluetooth Test...\n");

#if defined(CONFIG_BT_CENTRAL)
    printk("Role: CENTRAL\n");
    central_main();
#elif defined(CONFIG_BT_PERIPHERAL)
    printk("Role: PERIPHERAL\n");
    peripheral_main();
#else
    printk("Error: No role defined!\n");
#endif

    return 0;
}
```

## src/central.c
```c
#include <zephyr/kernel.h>
#include <zephyr/sys/printk.h>

void central_main(void)
{
    int i = 0;
    while(1) {
        printk("Central running... %d\n", i++);
        k_sleep(K_SECONDS(1));
    }
}
```

## src/peripheral.c
```c
#include <zephyr/kernel.h>
#include <zephyr/sys/printk.h>

void peripheral_main(void)
{
    int i = 0;
    while(1) {
        printk("Peripheral running... %d\n", i++);
        k_sleep(K_SECONDS(1));
    }
}
```
